## CMakeLists.txt
```
#-------------------------------------------------------------------------------
# Zephyr Example Application
#
# Copyright (c) 2021 Nordic Semiconductor ASA
# SPDX-License-Identifier: Apache-2.0

cmake_minimum_required(VERSION 3.13.1)
find_package(Zephyr REQUIRED HINTS $ENV{ZEPHYR_BASE})

project(app LANGUAGES C)

zephyr_include_directories(src)

target_sources(app PRIVATE src/main.c)
target_sources(app PRIVATE src/my_state_machine.c)
```

## prj.conf
```kconfig
# Copyright (c) 2021 Nordic Semiconductor ASA
# SPDX-License-Identifier: Apache-2.0
#
# This file contains selected Kconfig options for the application.

CONFIG_SYSTEM_WORKQUEUE_STACK_SIZE=2048

CONFIG_BT=y
CONFIG_BT_PERIPHERAL=y

CONFIG_BT_DEVICE_NAME="EiE BLE Peripheral 6584"
```

## src/main.c
```c
/*
 * main.c
 */

/* IMPORTS -------------------------------------------------------------------------------------- */

#include <stdio.h>
#include <string.h>
#include <stdbool.h>
#include <zephyr/bluetooth/bluetooth.h>
#include <zephyr/bluetooth/conn.h>
#include <zephyr/bluetooth/gatt.h>
#include <zephyr/bluetooth/hci.h>
#include <zephyr/bluetooth/uuid.h>
#include <zephyr/device.h>
#include <zephyr/devicetree.h>
#include <zephyr/drivers/display.h>
#include <zephyr/drivers/gpio.h>
#include <zephyr/kernel.h>
#include <zephyr/settings/settings.h>
#include <zephyr/sys/printk.h>

/* MACROS --------------------------------------------------------------------------------------- */

#define BLE_CUSTOM_SERVICE_UUID \
  BT_UUID_128_ENCODE(0x12345678, 0x1234, 0x5678, 0x1234, 0x56789abcdef0)
#define BLE_CUSTOM_CHARACTERISTIC_UUID \
  BT_UUID_128_ENCODE(0x12345678, 0x1234, 0x5678, 0x1234, 0x56789abcdef2)

#define BLE_CUSTOM_CHARACTERISTIC_MAX_DATA_LENGTH 20

/* LED DEFINITIONS ------------------------------------------------------------------------------ */

#define LED0_NODE DT_ALIAS(led0)

#if !DT_NODE_HAS_STATUS(LED0_NODE, okay)
#error "Unsupported board: led0 alias not defined"
#endif

static const struct gpio_dt_spec led1 = GPIO_DT_SPEC_GET(LED0_NODE, gpios);

/* BUTTON DEFINITIONS --------------------------------------------------------------------------- */

#define SW0_NODE DT_ALIAS(sw0)

#if !DT_NODE_HAS_STATUS(SW0_NODE, okay)
#error "Unsupported board: sw0 alias not defined"
#endif

static const struct gpio_dt_spec button1 = GPIO_DT_SPEC_GET(SW0_NODE, gpios);

/* PROTOTYPES ----------------------------------------------------------------------------------- */

static ssize_t ble_custom_service_read(struct bt_conn* conn, const struct bt_gatt_attr* attr,
                                       void* buf, uint16_t len, uint16_t offset);
static ssize_t ble_custom_service_write(struct bt_conn* conn, const struct bt_gatt_attr* attr,
                                        const void* buf, uint16_t len, uint16_t offset,
                                        uint8_t flags);

/* VARIABLES ------------------------------------------------------------------------------------ */

static const struct bt_uuid_128 ble_custom_service_uuid = BT_UUID_INIT_128(BLE_CUSTOM_SERVICE_UUID);
static const struct bt_uuid_128 ble_custom_characteristic_uuid =
    BT_UUID_INIT_128(BLE_CUSTOM_CHARACTERISTIC_UUID);

static const struct bt_data ble_advertising_data[] = {
    BT_DATA_BYTES(BT_DATA_FLAGS, (BT_LE_AD_GENERAL | BT_LE_AD_NO_BREDR)),
    BT_DATA_BYTES(BT_DATA_UUID128_ALL, BLE_CUSTOM_SERVICE_UUID),
};

static const struct bt_data ble_scan_response_data[] = {
    BT_DATA(BT_DATA_NAME_COMPLETE, CONFIG_BT_DEVICE_NAME, sizeof(CONFIG_BT_DEVICE_NAME) - 1),
};

static uint8_t ble_custom_characteristic_user_data[BLE_CUSTOM_CHARACTERISTIC_MAX_DATA_LENGTH + 1] =
    {'E', 'i', 'E'};

/* NOTIFY COUNTER STATE ------------------------------------------------------------------------- */

static int32_t notify_counter = 0;
static int8_t notify_direction = 1;  // +1 = counting up, -1 = counting down

/* LED STATE ------------------------------------------------------------------------------------ */

static bool led1_on = false;  // false = OFF, true = ON

/* BLE SERVICE SETUP ---------------------------------------------------------------------------- */

BT_GATT_SERVICE_DEFINE(
    ble_custom_service,  // Name of the struct that will store the config for this service
    BT_GATT_PRIMARY_SERVICE(&ble_custom_service_uuid),  // Setting the service UUID

    // Now to define the characteristic:
    BT_GATT_CHARACTERISTIC(
        &ble_custom_characteristic_uuid.uuid,  // Setting the characteristic UUID
        BT_GATT_CHRC_READ | BT_GATT_CHRC_WRITE | BT_GATT_CHRC_NOTIFY,  // Possible operations
        BT_GATT_PERM_READ | BT_GATT_PERM_WRITE,  // Permissions that connecting devices have
        ble_custom_service_read,             // Callback for when this characteristic is read from
        ble_custom_service_write,            // Callback for when this characteristic is written to
        ble_custom_characteristic_user_data  // Initial data stored in this characteristic
        ),
    BT_GATT_CCC(  // Client characteristic configuration for the above custom characteristic
        NULL,     // Callback for when this characteristic is changed
        BT_GATT_PERM_READ | BT_GATT_PERM_WRITE  // Permissions that connecting devices have
        ),

    // End of service definition
);

/* FUNCTIONS ------------------------------------------------------------------------------------ */

static ssize_t ble_custom_service_read(struct bt_conn* conn, const struct bt_gatt_attr* attr,
                                       void* buf, uint16_t len, uint16_t offset) {
  /* Challenge 3:
   * Instead of returning "EiE" or stored data,
   * always return the current LED 1 status: "ON" or "OFF".
   */
  const char* status_str = led1_on ? "ON" : "OFF";

  return bt_gatt_attr_read(conn, attr, buf, len, offset,
                           status_str, strlen(status_str));
}

static ssize_t ble_custom_service_write(struct bt_conn* conn, const struct bt_gatt_attr* attr,
                                        const void* buf, uint16_t len, uint16_t offset,
                                        uint8_t flags) {
  uint8_t* value = attr->user_data;

  if (offset + len > BLE_CUSTOM_CHARACTERISTIC_MAX_DATA_LENGTH) {
    printk("[BLE] ble_custom_service_write: Bad offset %d\n", offset + len);
    return BT_GATT_ERR(BT_ATT_ERR_INVALID_OFFSET);
  }

  memcpy(value + offset, buf, len);
  value[offset + len] = 0;

  printk("[BLE] ble_custom_service_write (%d, %d):", offset, len);
  for (uint16_t i = 0; i < len; i++) {
    printk("%s %02X '%c'", i == 0 ? "" : ",", value[offset + i], value[offset + i]);
  }
  printk("\n");

  /* Make a local, null-terminated copy of what was written */
  char text[BLE_CUSTOM_CHARACTERISTIC_MAX_DATA_LENGTH + 1];
  memcpy(text, buf, len);
  text[len] = '\0';

  /* Challenge 1 + 3: interpret LED commands and update LED + state flag */
  if (strcmp(text, "LED ON") == 0) {
    gpio_pin_set_dt(&led1, 1);   // turn LED 1 ON
    led1_on = true;              // remember state
    printk("[BLE] Command: LED ON\n");
  } else if (strcmp(text, "LED OFF") == 0) {
    gpio_pin_set_dt(&led1, 0);   // turn LED 1 OFF
    led1_on = false;             // remember state
    printk("[BLE] Command: LED OFF\n");
  }

  return len;
}

static void ble_custom_service_notify() {
  bt_gatt_notify(NULL, &ble_custom_service.attrs[2], &notify_counter, sizeof(notify_counter));
  notify_counter += notify_direction;
}

/* MAIN ----------------------------------------------------------------------------------------- */

int main(void) {
  int err = bt_enable(NULL);
  if (err) {
    printk("Bluetooth init failed (err %d)\n", err);
    return 0;
  } else {
    printk("Bluetooth initialized!\n");
  }

  err =
      bt_le_adv_start(BT_LE_ADV_CONN_FAST_1, ble_advertising_data, ARRAY_SIZE(ble_advertising_data),
                      ble_scan_response_data, ARRAY_SIZE(ble_scan_response_data));
  if (err) {
    printk("Advertising failed to start (err %d)\n", err);
    return 0;
  }

  /* Configure LED 1 as output and start it OFF */
  if (!device_is_ready(led1.port)) {
    printk("LED device not ready\n");
    return 0;
  }

  err = gpio_pin_configure_dt(&led1, GPIO_OUTPUT_INACTIVE);
  if (err < 0) {
    printk("Failed to configure LED (err %d)\n", err);
    return 0;
  }
  led1_on = false;  // ensure our flag matches the hardware

  /* Configure BUTTON 1 as input with pull-up */
  if (!device_is_ready(button1.port)) {
    printk("Button device not ready\n");
    return 0;
  }

  err = gpio_pin_configure_dt(&button1, GPIO_INPUT | GPIO_PULL_UP);
  if (err < 0) {
    printk("Failed to configure button (err %d)\n", err);
    return 0;
  }

  int last_button_state = 1;  // assume released at start (pull-up)

  while (1) {
    /* Read current BUTTON 1 state (0 = pressed, 1 = released) */
    int button_state = gpio_pin_get_dt(&button1);

    if (button_state < 0) {
      printk("Error reading button state (err %d)\n", button_state);
    } else {
      /* Detect a press: previously released (1), now pressed (0) */
      if (last_button_state == 1 && button_state == 0) {
        notify_direction = -notify_direction;  // flip +1 <-> -1
        printk("[BLE] Button 1 pressed, direction = %d\n", notify_direction);
      }
      last_button_state = button_state;
    }

    k_sleep(K_MSEC(1000));         // wait 1 second
    ble_custom_service_notify();   // send counter, then update it
  }
}
```

## src/BTN.h
```c
#ifndef BTN_H
#define BTN_H

#include <zephyr/kernel.h>
#include <zephyr/device.h>
#include <zephyr/drivers/gpio.h>
#include <stdbool.h>

/* Four buttons: 0..3 */
typedef enum {
    BTN0 = 0,  // sw0 -> BUTTON 1
    BTN1,      // sw1 -> BUTTON 2
    BTN2,      // sw2 -> BUTTON 3
    BTN3,      // sw3 -> BUTTON 4
    BTN_COUNT
} btn_id;

/* Map each BTN to a devicetree alias sw0..sw3 */
static const struct gpio_dt_spec btns[BTN_COUNT] = {
    GPIO_DT_SPEC_GET(DT_ALIAS(sw0), gpios),
    GPIO_DT_SPEC_GET(DT_ALIAS(sw1), gpios),
    GPIO_DT_SPEC_GET(DT_ALIAS(sw2), gpios),
    GPIO_DT_SPEC_GET(DT_ALIAS(sw3), gpios),
};

/* Per-button debounce state */
static bool btn_prev_level[BTN_COUNT] = { false };
static bool btn_latched[BTN_COUNT]    = { false };

/* Configure all buttons as inputs */
static inline int BTN_init(void)
{
    for (int i = 0; i < BTN_COUNT; ++i) {
        if (!device_is_ready(btns[i].port)) {
            return -1;
        }
        int ret = gpio_pin_configure_dt(&btns[i], GPIO_INPUT);
        if (ret < 0) {
            return ret;
        }
        /* Initialize previous level */
        btn_prev_level[i] = gpio_pin_get_dt(&btns[i]) ? true : false;
        btn_latched[i] = false;
    }
    return 0;
}

/*
 * Debounced “press” check for a specific button.
 * Returns true once per real press.
 */
static inline bool BTN_check_clear_pressed(btn_id btn)
{
    if (btn < 0 || btn >= BTN_COUNT) {
        return false;
    }

    bool level = gpio_pin_get_dt(&btns[btn]);
    bool prev  = btn_prev_level[btn];

    /* Rising edge detected */
    if (level && !prev) {
        /* Small debounce delay */
        k_msleep(10);
        level = gpio_pin_get_dt(&btns[btn]);
        if (level) {
            btn_latched[btn] = true;
        }
    }

    btn_prev_level[btn] = level;

    if (btn_latched[btn]) {
        btn_latched[btn] = false;
        return true;
    }

    return false;
}

#endif /* BTN_H */
```

## src/LED.h
```c
#ifndef LED_H
#define LED_H

#include <zephyr/kernel.h>
#include <zephyr/device.h>
#include <zephyr/drivers/gpio.h>

/* We only need LED 0 for the lesson */
typedef enum {
    LED0 = 0,
} led_id;

typedef enum {
    LED_OFF = 0,
    LED_ON  = 1,
} led_state;

/* LED0 alias from the board devicetree */
static const struct gpio_dt_spec led0 =
    GPIO_DT_SPEC_GET(DT_ALIAS(led0), gpios);

/* Configure LED0 as an output (starts off) */
static inline int LED_init(void)
{
    int ret;

    if (!device_is_ready(led0.port)) {
        return -1;
    }

    ret = gpio_pin_configure_dt(&led0, GPIO_OUTPUT_INACTIVE);
    if (ret < 0) {
        return ret;
    }

    return 0;
}

/* Toggle LED0 */
static inline int LED_toggle(led_id led)
{
    (void)led; /* only LED0 used for now */
    gpio_pin_toggle_dt(&led0);
    return 0;
}

/* Explicitly set LED0 on/off if you ever need it */
static inline int LED_set(led_id led, led_state state)
{
    (void)led;
    gpio_pin_set_dt(&led0, state == LED_ON ? 1 : 0);
    return 0;
}

#endif /* LED_H */
```

## src/my_state_machine.c
```c
/**
 * @file my_state_machine.c
 */

#include <zephyr/smf.h>
#include "LED.h"
#include "my_state_machine.h"

/*---------------------------------------------------------
 * Function Prototypes
 *---------------------------------------------------------*/
static void led_on_state_entry(void *o);
static enum smf_state_result led_on_state_run(void *o);
static void led_off_state_entry(void *o);
static enum smf_state_result led_off_state_run(void *o);

/*---------------------------------------------------------
 * Typedefs
 *---------------------------------------------------------*/
enum led_state_machine_states {
    LED_ON_STATE,
    LED_OFF_STATE
};

typedef struct {
    // Context variable used by Zephyr to track state machine state. Must be first
    struct smf_ctx ctx;
    uint16_t count;
} led_state_object_t;

/*---------------------------------------------------------
 * Local Variables
 *---------------------------------------------------------*/
static const struct smf_state led_states[] = {
    [LED_ON_STATE]  = SMF_CREATE_STATE(led_on_state_entry, led_on_state_run, NULL, NULL, NULL),
    [LED_OFF_STATE] = SMF_CREATE_STATE(led_off_state_entry, led_off_state_run, NULL, NULL, NULL)
};

static led_state_object_t led_state_object;

void state_machine_init(void) {
    led_state_object.count = 0;
    smf_set_initial(SMF_CTX(&led_state_object), &led_states[LED_ON_STATE]);
}

int state_machine_run(void) {
    return smf_run_state(SMF_CTX(&led_state_object));
}

static void led_on_state_entry(void *o) {
    LED_set(LED0, LED_ON);
}

static enum smf_state_result led_on_state_run(void *o) {
    if (led_state_object.count > 500) {
        led_state_object.count = 0;
        smf_set_state(SMF_CTX(&led_state_object), &led_states[LED_OFF_STATE]);
    } else {
        led_state_object.count++;
    }

    return SMF_EVENT_HANDLED;
}

static void led_off_state_entry(void *o) {
    LED_set(LED0, LED_OFF);
}

static enum smf_state_result led_off_state_run(void *o) {
    if (led_state_object.count > 500) {
        led_state_object.count = 0;
        smf_set_state(SMF_CTX(&led_state_object), &led_states[LED_ON_STATE]);
    } else {
        led_state_object.count++;
    }

    return SMF_EVENT_HANDLED;
}
```

## src/my_state_machine.h
```c
/**
 * @file my_state_machine.h
 */

#ifndef MY_STATE_MACHINE_H
#define MY_STATE_MACHINE_H

void state_machine_init();

int state_machine_run();

#endif // MY_STATE_MACHINE_H
```
